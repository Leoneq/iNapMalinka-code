/dts-v1/;
/plugin/;
/ {
        compatible = "brcm,bcm2835", "brcm,bcm2708", "brcm,bcm2709";
        fragment@0 {
                target = <&i2c1>;
                __overlay__ {
			#address-cells = <1>;
            #size-cells = <0>;
						
			ft6236: ft6236@38 {
				compatible = "focaltech,ft6236";
				reg = <0x38>;
				poll-interval = <10>;	
				touchscreen-size-x = <480>;
				touchscreen-size-y = <320>;
			};
                };
        };

	__overrides__ {
                touch-sizex = <&ft6236>,"touchscreen-size-x?";
                touch-sizey = <&ft6236>,"touchscreen-size-y?";
                touch-invx  = <&ft6236>,"touchscreen-inverted-x?";
                touch-invy  = <&ft6236>,"touchscreen-inverted-y?";
                touch-swapxy = <&ft6236>,"touchscreen-swapped-x-y?";
        };
};
